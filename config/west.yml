## config/west.yml
```yaml
manifest:
  defaults:
    remote: urob
    revision: v0.2 # Pin everything to v0.2
  remotes:
    - name: urob
      url-base: https://github.com/urob
    - name: zmkfirmware
      url-base: https://github.com/zmkfirmware
    - name: badjeff
      url-base: https://github.com/badjeff
  projects:
  - name: zmk
    remote: zmkfirmware
    import: app/west.yml
  - name: zmk-pmw3610-driver
    remote: badjeff
    revision: main
  - name: zmk-keyboards-charybdis
    url: https://github.com/Rocketfuelled/charybdis-zmk-module
    revision: main
    path: modules/zmk-keyboards-charybdis
  - name: zmk-adaptive-key
    path: modules/zmk/adaptive-key
  - name: zmk-tri-state
    path: modules/zmk/tri-state
  self:
    path: config
```
